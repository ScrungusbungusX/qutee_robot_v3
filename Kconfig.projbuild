## Kconfig.projbuild
```kconfig
 
menu "Project-specific overrides"

config FREERTOS_HZ_OVERRIDE
    int "Tick rate override"
    default 1000
    help
      Overrides the FreeRTOS tick rate.

endmenu
```

## sdkconfig.defaults
```kconfig
 
CONFIG_FREERTOS_HZ=1000
CONFIG_IDF_TARGET="esp32s3"
CONFIG_ARDUINO_VARIANT="esp32s3"
```
